/ {
	amba_pl: amba_pl {
		ranges;
		compatible = "simple-bus";
		#address-cells = <1>;
		#size-cells = <1>;
		PmodENC_0: PmodENC@40000000 {
			xlnx,rable = <0>;
			compatible = "xlnx,PmodENC-1.0";
			status = "okay";
			clock-names = "s_axi_aclk";
			xlnx,use-board-flow;
			xlnx,ip-name = "PmodENC";
			xlnx,pmod = "je";
			xlnx,edk-iptype = "PERIPHERAL";
			reg = <0x40000000 0x1000>;
			clocks = <&clkc 15>;
			xlnx,name = "PmodENC_0";
		};
	};
};
